/**
 * @file RRTOS_loop_subscribe_demo.cpp
 * @brief 演示在任务循环中订阅话题的方式
 * @author Generated by AI Assistant
 * @date 2025-05-15
 * @details 展示如何使用RRTOS系统的循环订阅方式
 */

#include <Arduino.h>
#include "RRTOS.h"

// 自定义数据类型
struct SensorData {
    float temperature;
    float humidity;
    float pressure;
    
    SensorData() : temperature(0), humidity(0), pressure(0) {}
    SensorData(float t, float h, float p) : temperature(t), humidity(h), pressure(p) {}
};

// 话题发布任务
void publisherTask(void* params) {
    // 延迟2秒，确保系统初始化完成
    vTaskDelay(pdMS_TO_TICKS(2000));
    Serial.println("发布者任务启动");
    
    // 创建不同类型的发布者
    auto intPub = RRTOS::pub<int>("int_topic");
    auto floatPub = RRTOS::pub<float>("float_topic");
    auto sensorPub = RRTOS::pub<SensorData>("sensor_topic");
    
    int counter = 0;
    float value = 0.0f;
    
    while (true) {
        // 发布整数数据
        bool intResult = intPub.publish(counter);
        Serial.printf("发布整数数据: %d, 结果: %s\n", counter, 
                      intResult ? "成功" : "失败");
        
        // 发布浮点数数据
        bool floatResult = floatPub.publish(value);
        Serial.printf("发布浮点数数据: %.2f, 结果: %s\n", value,
                      floatResult ? "成功" : "失败");
        
        // 发布传感器数据
        SensorData sensorData(25.0 + sin(value), 50.0 + cos(value), 1013.25);
        bool sensorResult = sensorPub.publish(sensorData);
        Serial.printf("发布传感器数据: 温度=%.1f, 湿度=%.1f, 气压=%.2f, 结果: %s\n", 
                      sensorData.temperature, sensorData.humidity, sensorData.pressure,
                      sensorResult ? "成功" : "失败");
        
        // 更新计数器和值
        counter++;
        value += 0.1;
        
        // 每2秒发布一次
        vTaskDelay(pdMS_TO_TICKS(2000));
    }
}

// 订阅者任务 - 使用循环订阅方式
void subscriberTask(void* params) {
    // 延迟3秒，确保发布者已经创建话题
    vTaskDelay(pdMS_TO_TICKS(3000));
    Serial.println("订阅者任务启动");
    
    // 创建订阅者，无需回调函数
    auto intSub = RRTOS::sub<int>("int_topic");
    auto floatSub = RRTOS::sub<float>("float_topic");
    auto sensorSub = RRTOS::sub<SensorData>("sensor_topic");
    
    // 订阅者在循环中接收消息
    while (true) {
        int intData;
        float floatData;
        SensorData sensorData;
        
        // 非阻塞方式接收整数数据（超时100ms）
        if (intSub->receive(intData, 100)) {
            Serial.printf("收到整数数据: %d\n", intData);
        }
        
        // 非阻塞方式接收浮点数据（超时100ms）
        if (floatSub->receive(floatData, 100)) {
            Serial.printf("收到浮点数数据: %.2f\n", floatData);
        }
        
        // 非阻塞方式接收传感器数据（超时100ms）
        if (sensorSub->receive(sensorData, 100)) {
            Serial.printf("收到传感器数据: 温度=%.1f, 湿度=%.1f, 气压=%.2f\n",
                        sensorData.temperature, sensorData.humidity, sensorData.pressure);
        }
        
        // 小延迟避免CPU占用过高
        vTaskDelay(pdMS_TO_TICKS(10));
    }
}

// Arduino setup函数
void setup() {
    Serial.begin(115200);
    delay(1000);
    
    Serial.println("\n===== RRTOS 循环订阅方式演示 =====");
    
    // 初始化RRTOS系统
    if (!RRTOS::initialize()) {
        Serial.println("错误: RRTOS系统初始化失败");
        return;
    }
    
    // 创建任务
    xTaskCreatePinnedToCore(publisherTask, "Publisher", 4096, NULL, 1, NULL, 0);
    xTaskCreatePinnedToCore(subscriberTask, "Subscriber", 4096, NULL, 1, NULL, 0);
    
    Serial.println("所有任务已启动");
}

void loop() {
    // 主循环中不需要做任何事情
    vTaskDelay(pdMS_TO_TICKS(1000));
}
