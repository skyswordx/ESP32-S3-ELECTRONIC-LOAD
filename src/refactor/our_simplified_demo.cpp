/**
 * @file our_simplified_demo.cpp
 * @brief 简化版系统演示代码
 * @author Generated by AI Assistant
 * @date 2025-05-19
 * @details 展示如何使用简化版通信系统
 */

#include "our.h"
#include "../lib/our_queue/our_queque.hpp"

using namespace OUR;

// 定义一个简单的消息类型
struct TestData {
    int value;
    float measurement;
    char text[32];
};

// 定义一个服务请求类型
struct AddRequest {
    int a;
    int b;
};

// 定义一个服务响应类型
struct AddResponse {
    int result;
};

// 服务回调函数
bool addServiceCallback(const AddRequest& req, AddResponse& resp) {
    Serial.printf("接收到计算请求: %d + %d\n", req.a, req.b);
    resp.result = req.a + req.b;
    return true;
}

// 话题回调函数（用于测试）
void topicCallback(const QueueElement_t<TestData>& element) {
    Serial.printf("接收到消息，来自任务ID: %d, 数据描述: %d\n", element.task_id, element.data_description);
    Serial.printf("消息内容: value=%d, measurement=%.2f, text=%s\n",
                element.data.value, element.data.measurement, element.data.text);
}

// 服务器任务
void serverTask(void* params) {
    // 创建服务
    auto server = advertiseService<AddRequest, AddResponse>("add_service", addServiceCallback);
    
    // 保持服务运行
    while (true) {
        delay(1000);
    }
}

// 客户端任务
void clientTask(void* params) {
    delay(1000); // 等待服务器启动
    
    // 创建客户端
    auto client = serviceClient<AddRequest, AddResponse>("add_service");
    
    int counter = 0;
    while (true) {
        // 构造请求
        AddRequest req;
        req.a = counter;
        req.b = counter * 2;
        
        // 发送请求
        AddResponse resp;
        if (client->call(req, resp, 1000)) {
            Serial.printf("计算结果: %d + %d = %d\n", req.a, req.b, resp.result);
        } else {
            Serial.println("调用服务失败");
        }
        
        counter++;
        delay(5000);
    }
}

// 发布者任务
void publisherTask(void* params) {
    // 创建发布者
    Publisher pub_test = OUR::pub<TestData>("test_topic");
    
    int counter = 0;
    while (true) {
        // 构造消息
        TestData data;
        data.value = counter;
        data.measurement = counter * 0.5f;
        snprintf(data.text, sizeof(data.text), "测试消息 #%d", counter);
        
        // 发布消息
        bool success = pub_test.publish(data, TASK_INA226, DATA_DESCRIPTION_VOLTAGE);
        if (success) {
            Serial.printf("发布消息成功: #%d\n", counter);
        } else {
            Serial.println("发布消息失败");
        }
        
        counter++;
        delay(2000);
    }
}

// 订阅者任务
void subscriberTask(void* params) {
    delay(1000); // 等待发布者启动
    
    // 创建订阅者
    auto sub_test = OUR::sub<TestData>("test_topic");
    
    while (true) {
        // 接收消息
        QueueElement_t<TestData> element;
        if (sub_test->receive(element, 5000)) {
            topicCallback(element);
        } else {
            Serial.println("接收消息超时");
        }
    }
}

void setup() {
    Serial.begin(115200);
    delay(2000); // 等待串口初始化
    
    Serial.println("正在启动系统演示...");
    
    // 初始化系统
    if (!OUR::init()) {
        Serial.println("系统初始化失败");
        return;
    }
    
    // 创建任务
    xTaskCreate(serverTask, "ServerTask", 4096, NULL, 3, NULL);
    xTaskCreate(clientTask, "ClientTask", 4096, NULL, 2, NULL);
    xTaskCreate(publisherTask, "PubTask", 4096, NULL, 2, NULL);
    xTaskCreate(subscriberTask, "SubTask", 4096, NULL, 2, NULL);
}

void loop() {
    // 主循环为空，所有工作都在任务中完成
    delay(1000);
}
